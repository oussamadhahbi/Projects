## conf/local.conf
```bitbake
MACHINE ?= "raspberrypi3"
DL_DIR ?= "${TOPDIR}/../../downloads"
SSTATE_DIR = "${TOPDIR}/../../sstate-cache"
DISTRO ?= "poky"
PACKAGE_CLASSES ?= "package_rpm"
CONF_VERSION = "1"
INHERIT += "extrausers"

IMAGE_INSTALL_append = "images";
IMAGE_INSTALL_append = "init-ifupdown"
IMAGE_INSTALL_append = "wpa-supplicant"

LICENSE_FLAGS_WHITELIST_append = " commercial_faad2"
VIRTUAL-RUNTIME_init_manager = "systemd"
DISTRO_FEATURES_append = " systemd"
DISTRO_FEATURES_BACKFILL_CONSIDERED = "sysvinit"

IMAGE_ROOTFS_EXTRA_SPACE = "5242880"

IMAGE_INSTALL_append = " x11vnc"

IMAGE_INSTALL_append = " make cmake"
IMAGE_INSTALL_append = " qtbase-tools qtbase qtdeclarative qtimageformats qtmultimedia qtquickcontrols2 qtquickcontrols qtbase-plugins cinematicexperience liberation-fonts"

PACKAGECONFIG_FONTS_append_pn-qtbase = " fontconfig"

## Prise en charge du réseau ##
IMAGE_INSTALL_append = "opensh-sftp-server rsync"
#DISTRO_FEATURES_append = "wifi"

##Python ##

CORE_IMAGE_EXTRA_INSTALL = "python-core python-pip"
IMAGE_INSTALL_append = " python3-requests python3-pip"

DISTRO_FEATURES_remove = "x11 wayland"

## Bluetooth ##
MACHINE_FEATURES += " bluetooth"
CORE_IMAGE_EXTRA_INSTALL = " rsync "
DISTRO_FEATURES_append = " pi-bluetooth bluez5 bluetooth linux-firmware-bcm43430 linux-firmware-brcmfmac43430"
IMAGE_INSTALL_append = " pi-bluetooth bluez5 bluez5-testtools linux-firmware-bcm43430 i2c-tools hostapd dhcp-server udev-rules-rpi bridge-utils iptables linux-firmware-ralink linux-firmware-rtl8192ce linux-firmware-rtl8192cu linux-firmware-rtl8192su linux-firmware-rpidistro-bcm43430"
ENABLE_UART = "1"

IMAGE_INSTALL_append = " strace"
```
